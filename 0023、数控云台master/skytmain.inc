_CirCode:
	.DB  0x0,0x0,0x0,0x0,0x0,0x0,0x0,0x0
	.DB  0x80,0x80,0x40,0x20,0x20,0x10,0x8,0x8
	.DB  0x8,0x4,0x4,0x4,0x4,0x4,0x2,0x2
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	.DB  0x1,0x0,0x0,0x0,0x0,0x0,0x0,0x0
_HZcode:
	.DB  0x88,0xA8,0xE8,0x98,0x80,0x8,0xE8,0x38
	.DB  0xA8,0x28,0xE8,0x0,0x0,0x0,0x0,0x0
	.DB  0x20,0x20,0x3F,0x0,0x21,0x20,0x17,0x8
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	.DB  0x2B,0x2A,0x23,0x0,0x0,0x0,0x0,0x0
_DegreeCode:
	.DB  0x0,0x0,0x0,0x0,0x0,0x0,0x0,0x0
	.DB  0x0,0x0,0x0,0x0,0x0,0x0,0x0,0x0
	.DB  0xFF,0x0,0x0,0x0,0x0,0x0,0x0,0x0
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	.DB  0x0,0x0,0x0,0x0,0x0,0x0,0x0,0x80
	.DEF _rx_wr_index=R4
	.DEF _rx_rd_index=R5
	.DEF _rx_counter=R6
	.DEF _uc_syssta=R7
	.DEF _tx_wr_index=R8
	.DEF _tx_rd_index=R9
	.DEF _tx_counter=R10
	.DEF _ucInputValue=R11
	.DEF _ucInputParam0=R12
	.DEF _ucChannelN=R13
	.DEF _uc_ReceiveSta=R14
_tbl10_G3:
	.DB  0x10,0x27,0xE8,0x3,0x64,0x0,0xA,0x0
	.DB  0x1,0x0
_tbl16_G3:
	.DB  0x0,0x10,0x0,0x1,0x10,0x0,0x1,0x0
_0:
	.DB  0x52,0x65,0x61,0x64,0x79,0x3F,0x0,0x6F
	.DB  0x6B,0x0

__GLOBAL_INI_TBL:
	.DW  0
_0x107:
