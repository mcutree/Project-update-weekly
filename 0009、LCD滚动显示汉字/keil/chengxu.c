#include<reg51.h>
#include<absacc.h>
typedef unsigned char uchar;
typedef unsigned int uint;
#define LLCD_CMD_WR PBYTE[0x10]
#define LLCD_CMD_RD PBYTE[0x11]
#define LLCD_DATA_WR PBYTE[0x12]
#define LLCD_DATA_RD PBYTE[0x13]

#define RLCD_CMD_WR PBYTE[0x20]
#define RLCD_CMD_RD PBYTE[0x21]
#define RLCD_DATA_WR PBYTE[0x22]
#define RLCD_DATA_RD PBYTE[0x23]
sbit busy=P0^1;

uchar code hz0[]=
{
0x00, 0x00, 0xf8, 0x88, 0x99, 0xea, 0x8c, 0xf8, 0x88, 0xcc, 0xab, 0x99, 0x88, 0xf8, 0x00, 0x00, 
0x00, 0x00, 0x00, 0x00, 0xfe, 0x4a, 0x4a, 0x4a, 0x4a, 0x4a, 0x4a, 0xfe, 0x00, 0x00, 0x00, 0x00,

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0x00, 0x00, 0x58, 0x38, 0x00, 0x00, 0x00, 0x00, 0x00, 0x00, 0x00, 0x00, 0x00, 0x00, 0x00, 0x00
};

uchar code hz1[]=
{
0xfe, 0x02, 0x32, 0xca, 0x46, 0x20, 0x30, 0x2c, 0xe3, 0x24, 0x28, 0x10, 0x20, 0x20, 0x00, 0x00, 
0xff, 0x02, 0x04, 0x43, 0x20, 0x11, 0x4d, 0x81, 0x7f, 0x01, 0x05, 0x09, 0x11, 0x30, 0x00, 0x00, 

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0x00, 0x00, 0x5b, 0x3b, 0x00, 0x00, 0x00, 0x00, 0x00, 0x00, 0x00, 0x00, 0x00, 0x00, 0x00, 0x00
};

uchar code hz2[]=
{
0x02, 0x02, 0xfe, 0x92, 0x92, 0x92, 0xfe, 0x02, 0x02, 0x7c, 0x84, 0x04, 0x84, 0x7c, 0x04, 0x00, 
0x10, 0x10, 0x0f, 0x08, 0x08, 0x04, 0xff, 0x04, 0x22, 0x10, 0x09, 0x06, 0x09, 0x30, 0x10, 0x00, 

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0x00, 0x00, 0x58, 0x38, 0x00, 0x00, 0x00, 0x00, 0x00, 0x00, 0x00, 0x00, 0x00, 0x00, 0x00, 0x00 
};

uchar code hz3[]=
{
0x00, 0x00, 0x42, 0x44, 0x5c, 0x48, 0x40, 0xff, 0x40, 0x50, 0x48, 0x46, 0x64, 0x40, 0x00, 0x00, 
0x00, 0x04, 0x04, 0x04, 0x04, 0x04, 0x04, 0xff, 0x04, 0x04, 0x04, 0x04, 0x04, 0x06, 0x04, 0x00, 

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0x00, 0x18, 0x24, 0x24, 0x18, 0x00, 0x00, 0x00, 0x00, 0x00, 0x00, 0x00, 0x00, 0x00, 0x00, 0x00,

};

void lcd_cmd_wr(uchar cmdcode,uchar f);
void lcd_data_wr(uchar ldata,uchar f);
void chech_busy(uchar f);
void lcd_hz_wr(uchar posx,uchar posy,uchar *hz);
void lcd_str_wr(uchar row,uchar col,uchar n,uchar *str);
void lcd_rol();
void lcd_init();
void delay(uint n);

void main()
{
  while(1)
  {
   lcd_init();
   lcd_str_wr(0,0,8,hz0);
   delay(100);
   lcd_str_wr(1,0,8,hz1);
   delay(100);
   lcd_str_wr(2,0,8,hz2);
   delay(100);
   lcd_str_wr(3,0,8,hz3);
   delay(100);
   lcd_rol();
   delay(1000);
   lcd_rol();
   delay(1000);
  }
}

void lcd_init()
{
  uint i;
  lcd_cmd_wr(0x3f,0);
  lcd_cmd_wr(0xc0,0);
  lcd_cmd_wr(0xb8,0);
  lcd_cmd_wr(0x40,0);
  lcd_cmd_wr(0x3f,1);
  lcd_cmd_wr(0xc0,1);
  lcd_cmd_wr(0xb8,1);
  lcd_cmd_wr(0x40,1);
  for(i=0;i<256;i++)
  {
    lcd_data_wr(0x00,0);
	lcd_data_wr(0x00,1);
  }
  lcd_cmd_wr(0xb8+4,0);
  lcd_cmd_wr(0xb8+4,1);
  for(i=0;i<256;i++)
  {
    lcd_data_wr(0x00,0);
	lcd_data_wr(0x00,1);
  }
}

void lcd_cmd_wr(uchar cmdcode,uchar f)
{
  chech_busy(f);
  if(f==0) LLCD_CMD_WR=cmdcode;
  else RLCD_CMD_WR=cmdcode;
}

void chech_busy(uchar f)
{
  if(f==0) LLCD_CMD_RD;
  else RLCD_CMD_RD;
  while(busy);
}

void lcd_str_wr(uchar row,uchar col,uchar n,uchar *str)
{
  uchar i;
  for(i=0;i<n;i++)
  {
    lcd_hz_wr(row,col,str+i*32);
	delay(50);
	col++;
  }
}

void lcd_hz_wr(uchar posx,uchar posy,uchar *hz)
{
  uchar i;
  if(posy<4)
  {
    lcd_cmd_wr(0xb8+2*posx,0);
	lcd_cmd_wr(0x40+16*posy,0);
	for(i=0;i<16;i++) lcd_data_wr(hz[i],0);
	lcd_cmd_wr(0xb8+2*posx+1,0);
	lcd_cmd_wr(0x40+16*posy,0);
	for(i=16;i<32;i++) lcd_data_wr(hz[i],0);
  }
  else
  {
    lcd_cmd_wr(0xb8+2*posx,1);
	lcd_cmd_wr(0x40+16*(posy-4),1);
	for(i=0;i<16;i++) lcd_data_wr(hz[i],1);
	lcd_cmd_wr(0xb8+2*posx+1,1);
	lcd_cmd_wr(0x40+16*(posy-4),1);
	for(i=16;i<32;i++) lcd_data_wr(hz[i],1); 
  }
}

void lcd_data_wr(uchar ldata,uchar f)
{
  chech_busy(f);
  if(f==0) LLCD_DATA_WR=ldata;
  else RLCD_DATA_WR=ldata;
}

void lcd_rol()
{
  uchar i;
  for(i=0;i<64;i++)
  {
    lcd_cmd_wr(0xc0+i,0);
	lcd_cmd_wr(0xc0+i,1);
	delay(10);
  }
}

void delay(uint n)
{
  uint i;
  for(;n>0;n--)
	  for(i=500;i>0;i--);
}